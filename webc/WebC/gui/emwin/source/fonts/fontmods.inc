###############################################################################
#  Precompiled Font modules
###############################################################################

fontmods =  PreFont
fontmods += Sans1 Sans1b Sans1i Sans1bi 
fontmods += Sans2 Sans2b Sans2i Sans2bi 
fontmods += Sans3 Sans3b Sans3i Sans3bi 
fontmods += Sans4 Sans4b Sans4i Sans4bi 
fontmods += Sans5 Sans5b Sans5i Sans5bi 
fontmods += Sans6 Sans6b Sans6i Sans6bi 
fontmods += Sans7 Sans7b Sans7i Sans7bi
fontmods += Times1 Times1b Times1i Times1bi 
fontmods += Times2 Times2b Times2i Times2bi 
fontmods += Times3 Times3b Times3i Times3bi 
fontmods += Times4 Times4b Times4i Times4bi 
fontmods += Times5 Times5b Times5i Times5bi 
fontmods += Times6 Times6b Times6i Times6bi 
fontmods += Times7 Times7b Times7i Times7bi

#ifeq ($(UNICODE_ENABLED),1)
#fontmods += ArialUnicode
#endif