###############################################################################
#  Precompiled Font modules
###############################################################################

fontmods  = webfonts
fontmods += wfemwin
fontmods += wfnucleus
fontmods += wfpeg
fontmods += wfwindows
fontmods += Arial10
fontmods += Arial10b
fontmods += Arial10bi
fontmods += Arial10i
fontmods += Arial11
fontmods += Arial11b
fontmods += Arial11bi
fontmods += Arial11i
fontmods += Arial12
fontmods += Arial12b
fontmods += Arial12bi
fontmods += Arial12i
fontmods += Arial13
fontmods += Arial13b
fontmods += Arial13bi
fontmods += Arial13i
fontmods += Arial14
fontmods += Arial14b
fontmods += Arial14bi
fontmods += Arial14i
fontmods += Arial16
fontmods += Arial16b
fontmods += Arial16bi
fontmods += Arial16i
fontmods += Arial18
fontmods += Arial18b
fontmods += Arial18bi
fontmods += Arial18i
fontmods += Arial20
fontmods += Arial20b
fontmods += Arial20bi
fontmods += Arial20i
fontmods += Arial24
fontmods += Arial24b
fontmods += Arial24bi
fontmods += Arial24i
fontmods += Arial30
fontmods += Arial30b
fontmods += Arial30bi
fontmods += Arial30i
fontmods += Arial36
fontmods += Arial36b
fontmods += Arial36bi
fontmods += Arial36i
fontmods += Arial6
fontmods += Arial6b
fontmods += Arial6bi
fontmods += Arial6i
fontmods += Arial7
fontmods += Arial7b
fontmods += Arial7bi
fontmods += Arial7i
fontmods += Arial8
fontmods += Arial8b
fontmods += Arial8bi
fontmods += Arial8i
fontmods += Arial9
fontmods += Arial9b
fontmods += Arial9bi
fontmods += Arial9i
fontmods += Courier10
fontmods += Courier10b
fontmods += Courier10bi
fontmods += Courier10i
fontmods += Courier11
fontmods += Courier11b
fontmods += Courier11bi
fontmods += Courier11i
fontmods += Courier12
fontmods += Courier12b
fontmods += Courier12bi
fontmods += Courier12i
fontmods += Courier13
fontmods += Courier13b
fontmods += Courier13bi
fontmods += Courier13i
fontmods += Courier14
fontmods += Courier14b
fontmods += Courier14bi
fontmods += Courier14i
fontmods += Courier16
fontmods += Courier16b
fontmods += Courier16bi
fontmods += Courier16i
fontmods += Courier18
fontmods += Courier18b
fontmods += Courier18bi
fontmods += Courier18i
fontmods += Courier20
fontmods += Courier20b
fontmods += Courier20bi
fontmods += Courier20i
fontmods += Courier24
fontmods += Courier24b
fontmods += Courier24bi
fontmods += Courier24i
fontmods += Courier30
fontmods += Courier30b
fontmods += Courier30bi
fontmods += Courier30i
fontmods += Courier36
fontmods += Courier36b
fontmods += Courier36bi
fontmods += Courier36i
fontmods += Courier6
fontmods += Courier6b
fontmods += Courier6bi
fontmods += Courier6i
fontmods += Courier7
fontmods += Courier7b
fontmods += Courier7bi
fontmods += Courier7i
fontmods += Courier8
fontmods += Courier8b
fontmods += Courier8bi
fontmods += Courier8i
fontmods += Courier9
fontmods += Courier9b
fontmods += Courier9bi
fontmods += Courier9i
fontmods += Times10
fontmods += Times10b
fontmods += Times10bi
fontmods += Times10i
fontmods += Times11
fontmods += Times11b
fontmods += Times11bi
fontmods += Times11i
fontmods += Times12
fontmods += Times12b
fontmods += Times12bi
fontmods += Times12i
fontmods += Times13
fontmods += Times13b
fontmods += Times13bi
fontmods += Times13i
fontmods += Times14
fontmods += Times14b
fontmods += Times14bi
fontmods += Times14i
fontmods += Times16
fontmods += Times16b
fontmods += Times16bi
fontmods += Times16i
fontmods += Times18
fontmods += Times18b
fontmods += Times18bi
fontmods += Times18i
fontmods += Times20
fontmods += Times20b
fontmods += Times20bi
fontmods += Times20i
fontmods += Times24
fontmods += Times24b
fontmods += Times24bi
fontmods += Times24i
fontmods += Times30
fontmods += Times30b
fontmods += Times30bi
fontmods += Times30i
fontmods += Times36
fontmods += Times36b
fontmods += Times36bi
fontmods += Times36i
fontmods += TIMES6
fontmods += TIMES6B
fontmods += TIMES6BI
fontmods += TIMES6I
fontmods += TIMES7
fontmods += TIMES7B
fontmods += TIMES7BI
fontmods += TIMES7I
fontmods += Times8
fontmods += Times8b
fontmods += Times8bi
fontmods += Times8i
fontmods += Times9
fontmods += Times9b
fontmods += Times9bi
fontmods += Times9i
fontmods += Verdana10
fontmods += Verdana10b
fontmods += Verdana10bi
fontmods += Verdana10i
fontmods += Verdana11
fontmods += Verdana11b
fontmods += Verdana11bi
fontmods += Verdana11i
fontmods += Verdana12
fontmods += Verdana12b
fontmods += Verdana12bi
fontmods += Verdana12i
fontmods += Verdana13
fontmods += Verdana13b
fontmods += Verdana13bi
fontmods += Verdana13i
fontmods += Verdana14
fontmods += Verdana14b
fontmods += Verdana14bi
fontmods += Verdana14i
fontmods += Verdana16
fontmods += Verdana16b
fontmods += Verdana16bi
fontmods += Verdana16i
fontmods += Verdana18
fontmods += Verdana18b
fontmods += Verdana18bi
fontmods += Verdana18i
fontmods += Verdana20
fontmods += Verdana20b
fontmods += Verdana20bi
fontmods += Verdana20i
fontmods += Verdana24
fontmods += Verdana24b
fontmods += Verdana24bi
fontmods += Verdana24i
fontmods += Verdana30
fontmods += Verdana30b
fontmods += Verdana30bi
fontmods += Verdana30i
fontmods += Verdana36
fontmods += Verdana36b
fontmods += Verdana36bi
fontmods += Verdana36i
fontmods += Verdana6
fontmods += Verdana6b
fontmods += Verdana6bi
fontmods += Verdana6i
fontmods += Verdana7
fontmods += Verdana7b
fontmods += Verdana7bi
fontmods += Verdana7i
fontmods += Verdana8
fontmods += Verdana8B
fontmods += Verdana8bi
fontmods += Verdana8i
fontmods += Verdana9
fontmods += Verdana9b
fontmods += Verdana9bi
fontmods += Verdana9i

ifeq ($(UNICODE_ENABLED),1)
fontmods += ArialUnicode
endif